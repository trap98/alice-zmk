## config/boards/shields/alicee/Kconfig.defconfig
```kconfig
if SHIELD_ALICEE_RIGHT

config ZMK_KEYBOARD_NAME
    default "Alicee"

config ZMK_SPLIT_ROLE_CENTRAL
    default y
endif

if SHIELD_ALICEE_LEFT || SHIELD_ALICEE_RIGHT

config ZMK_SPLIT
    default y

endif
```

## config/boards/shields/alicee/Kconfig.shield
```kconfig
config SHIELD_ALICEE_LEFT
    def_bool $(shields_list_contains,alicee_left)

config SHIELD_ALICEE_RIGHT
    def_bool $(shields_list_contains,alicee_right)
```
